## app/boards/shields/paradigm_shift/Kconfig.defconfig
```kconfig
# Copyright (c) 2020 The ZMK Contributors
# SPDX-License-Identifier: MIT

if SHIELD_PARADIGM_SHIFT_LEFT

config ZMK_KEYBOARD_NAME
	default "paradigmShift"

config ZMK_SPLIT_ROLE_CENTRAL
	default y

endif

if SHIELD_PARADIGM_SHIFT_LEFT || SHIELD_PARADIGM_SHIFT_RIGHT

config ZMK_SPLIT
	default y

endif
```

## app/boards/shields/paradigm_shift/Kconfig.shield
```kconfig
# Copyright (c) 2020 The ZMK Contributors
# SPDX-License-Identifier: MIT

config SHIELD_PARADIGM_SHIFT_LEFT
	def_bool $(shields_list_contains,paradigm_shift_left)

config SHIELD_PARADIGM_SHIFT_RIGHT
	def_bool $(shields_list_contains,paradigm_shift_right)
```
